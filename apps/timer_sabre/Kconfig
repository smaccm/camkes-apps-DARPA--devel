## apps/timer_sabre/Kconfig
```kconfig
#
# Copyright 2014, NICTA
#
# This software may be distributed and modified according to the terms of
# the GNU General Public License version 2. Note that NO WARRANTY is provided.
# See "LICENSE_GPLv2.txt" for details.
#
# @TAG(NICTA_GPL)
#

menuconfig APP_TIMER_SABRE
    bool "Sabre Timer test application"
    default n
    help 
        Application to test the TimeServer component on the SabreLite.
```
